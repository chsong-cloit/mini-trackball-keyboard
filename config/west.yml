## config/west.yml
```yaml
manifest:
  remotes:
    - name: zmk
      url-base: https://github.com/zmkfirmware
    - name: nice
      url-base: https://github.com/noroadsleft

  projects:
    - name: zmk
      remote: zmk
      revision: main
      import: app/west.yml
```
